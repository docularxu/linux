## Documentation/devicetree/bindings/dma/marvell,mmp-dma.yaml
```yaml
# SPDX-License-Identifier: (GPL-2.0-only OR BSD-2-Clause)
%YAML 1.2
---
$id: http://devicetree.org/schemas/dma/marvell,mmp-dma.yaml#
$schema: http://devicetree.org/meta-schemas/core.yaml#

title: Marvell MMP DMA controller

maintainers:
  - Duje Mihanović <duje.mihanovic@skole.hr>

description:
  Marvell MMP SoCs may have two types of DMA controllers, peripheral and audio.

properties:
  compatible:
    enum:
      - marvell,pdma-1.0
      - marvell,adma-1.0
      - marvell,pxa910-squ
      - spacemit,k1-pdma

  reg:
    maxItems: 1

  interrupts:
    description:
      Interrupt lines for the controller, may be shared or one per DMA channel
    minItems: 1

  asram:
    description:
      A phandle to the SRAM pool
    $ref: /schemas/types.yaml#/definitions/phandle

  clocks:
    description: Clock for the controller
    maxItems: 1

  resets:
    description: Reset controller for the DMA controller
    maxItems: 1

  '#dma-cells':
    description:
      DMA specifier, consisting of a phandle to DMA controller plus the
      following integer cells

  '#dma-channels':
    deprecated: true

  '#dma-requests':
    deprecated: true

required:
  - compatible
  - reg
  - interrupts
  - '#dma-cells'

allOf:
  - $ref: dma-controller.yaml#
  - if:
      properties:
        compatible:
          contains:
            enum:
              - marvell,pdma-1.0
              - spacemit,k1-pdma
    then:
      properties:
        asram: false
    else:
      required:
        - asram
  - if:
      properties:
        compatible:
          contains:
            const: spacemit,k1-pdma
    then:
      required:
        - clocks
        - resets
    else:
      properties:
        clocks: false
        resets: false
  - if:
      properties:
        compatible:
          contains:
            enum:
              - marvell,pdma-1.0
              - spacemit,k1-pdma
    then:
      properties:
        '#dma-cells':
          const: 2
          description:
            The first cell contains the DMA request number for the peripheral
            device. The second cell is currently unused but must be present for
            backward compatibility.
    else:
      properties:
        '#dma-cells':
          const: 1
          description:
            The cell contains the DMA request number for the peripheral device.

unevaluatedProperties: false

examples:
  - |
    dma-controller@d4000000 {
        compatible = "marvell,pdma-1.0";
        reg = <0xd4000000 0x10000>;
        interrupts = <47>;
        #dma-cells = <2>;
        dma-channels = <16>;
    };
```

## Documentation/devicetree/bindings/mfd/hisilicon,hi655x.txt
```
Hisilicon hi655x Power Management Integrated Circuit (PMIC)

Required properties:
- compatible: Should be "hisilicon,hi655x-pmic"
- reg: Base address of PMIC on hi6220 soc
- interrupt-controller: Hi655x has internal IRQs (has own IRQ domain).
- pmic-gpios: The gpio used by pmic irq.

Example:
        pmic: pmic@f8000000 {
                compatible = "hisilicon,hi655x-pmic";
                reg = <0x0 0xf8000000 0x0 0x1000>;
                #interrupt-cells = <2>;
                interrupt-controller;
                pmic-gpios = <&gpio_pmu_irq_n>;
                status = "okay";
        }
```

## Documentation/devicetree/bindings/mfd/spacemit,p1.yaml
```yaml
# SPDX-License-Identifier: GPL-2.0-only OR BSD-2-Clause
%YAML 1.2
---
$id: http://devicetree.org/schemas/mfd/spacemit,p1.yaml#
$schema: http://devicetree.org/meta-schemas/core.yaml#

title: P1 Power Management Integrated Circuit

maintainers:
  - Troy Mitchell <troymitchell988@gmail.com>

description:
  PMIC chip P1 produced by SpacemiT. The device consists of I2C controlled MFD,
  which contains regulator, pinctrl, pwrkey and rtc.

properties:
  compatible:
    const: spacemit,p1-pmic

  reg:
    maxItems: 1

  interrupts:
    maxItems: 1

  regulators:
    type: object

    properties:
      compatible:
        const: pmic,p1-regulator

    required:
      - compatible

    patternProperties:
      "^(dcdc-reg[1-6]|aldo-reg[1-4]|dldo-reg[1-7]|switch)$":
        type: object
        $ref: /schemas/regulator/regulator.yaml#
        unevaluatedProperties: false

    unevaluatedProperties: false

  pinctrl:
    type: object

    properties:
      compatible:
        const: pmic,p1-pinctrl

      "#gpio-cells":
        const: 2

      gpio-controller: true

    required:
      - compatible
      - "#gpio-cells"
      - gpio-controller

    unevaluatedProperties: false

  pwrkey:
    type: object
    $ref: /schemas/input/input.yaml#

    properties:
      compatible:
        const: pmic,p1-pwrkey

    required:
      - compatible

    unevaluatedProperties: false

  rtc:
    type: object
    $ref: /schemas/rtc/rtc.yaml#

    properties:
      compatible:
        const: pmic,p1-rtc

    required:
      - compatible

    unevaluatedProperties: false


required:
  - compatible
  - reg
  - interrupts

unevaluatedProperties: false

examples:
  - |
    i2c {
        #address-cells = <1>;
        #size-cells = <0>;

        pmic@41 {
            compatible = "spacemit,p1";
            reg = <0x41>;
            interrupt-parent = <&intc>;
            interrupts = <64>;

            regulators {
                compatible = "pmic,p1-regulator";

                dcdc-reg1 {
                    regulator-name = "dcdc1";
                    regulator-min-microvolt = <500000>;
                    regulator-max-microvolt = <3450000>;
                    regulator-ramp-delay = <5000>;
                    regulator-always-on;
                };

                aldo-reg1 {
                    regulator-name = "aldo1";
                    regulator-min-microvolt = <500000>;
                    regulator-max-microvolt = <3400000>;
                    regulator-boot-on;
                };

                dldo-reg1 {
                    regulator-name = "dldo1";
                    regulator-min-microvolt = <500000>;
                    regulator-max-microvolt = <3400000>;
                    regulator-boot-on;
                };

                switch {
                    regulator-name = "switch";
                };
            };

            pinctrl {
                    compatible = "pmic,p1-pinctrl";
                    gpio-controller;
                    #gpio-cells = <2>;
            };

            pwrkey {
                compatible = "pmic,p1-pwrkey";
            };

            rtc {
                compatible = "pmic,p1-rtc";
            };
        };
    };
```

## Documentation/devicetree/bindings/regulator/hisilicon,hi655x-regulator.txt
```
Hisilicon Hi655x Voltage regulators

Note:
The hi655x regulator control is managed by hi655x Power IC.
So the node of this regulator must be child node of hi655x
pmic node.

The driver uses the regulator core framework, so please also
take the bindings of regulator.txt for reference.

Required properties:
- compatible: Must be "hisilicon,hi655x-regulator-pmic";
- regulator-ctrl-regs: Registers offset of control register,
  In turn with enable disable and status register offset.
- regulator-ctrl-mask: The control mask bit of the register.
- regulator-vset-regs: Voltage set register offset.
- regulator-vset-mask: voltage set control mask.
- regulator-n-vol: The num of support voltages.
- regulator-vset-table: The table of support voltages.

Example:
        pmic: pmic@f8000000 {
                compatible = "hisilicon,hi655x-pmic";
		...
		ldo7: regulator@a26 {
			compatible = "hisilicon,hi655x-regulator-pmic";
			regulator-name = "ldo7";
			regulator-min-microvolt = <1800000>;
			regulator-max-microvolt = <3300000>;
			regulator-valid-modes-mask = <0x0a>;
			regulator-enable-ramp-delay = <120>;
			regulator-ctrl-regs = <0x029 0x02a 0x02b>;
			regulator-ctrl-mask = <0x6>;
			regulator-vset-regs = <0x078>;
			regulator-vset-mask = <0x7>;
			regulator-n-vol = <8>;
			regulator-vset-table  = <1800000>,<1850000>,
						<2850000>,<2900000>,
						<3000000>,<3100000>,
						<3200000>,<3300000>;
		};
		...
	}
```

## drivers/media/platform/hisilicon/Kconfig
```kconfig
#
# hisilicon isp device configuration.
# Please keep this list sorted alphabetically

source "drivers/media/platform/hisilicon/isp/Kconfig"
```

## drivers/media/platform/hisilicon/isp/Kconfig
```kconfig
config HISI_KIRIN_ISP
	tristate "ISP Support for Hisilicon Kirin Platform"
	depends on V4L_PLATFORM_DRIVERS
	default n
	help
	  ISP Support for Hisilicon Kirin Platform
```

## Documentation/devicetree/bindings/soc/spacemit/spacemit,k1-mbus.yaml
```yaml
# SPDX-License-Identifier: (GPL-2.0 OR BSD-2-Clause)
%YAML 1.2
---
$id: http://devicetree.org/schemas/soc/spacemit/spacemit,k1-mbus.yaml#
$schema: http://devicetree.org/meta-schemas/core.yaml#

title: SpacemiT Memory Bus controller

maintainers:
  - Ze Huang <huangze9015@gmail.com>

description: |
  On the SpacemiT K1 SoC, some devices do not perform DMA through their
  immediate parent node in the device tree. Instead, they access memory
  through a separate memory bus (MBUS) that uses a different address
  mapping from the CPU.

  To correctly describe the DMA path, such devices must reference the MBUS
  controller through an interconnect with the reserved name "dma-mem".

properties:
  compatible:
    const: spacemit,k1-mbus

  reg:
    maxItems: 1

  dma-ranges:
    maxItems: 1

  "#address-cells": true

  "#size-cells": true

  "#interconnect-cells":
    const: 0

required:
  - compatible
  - reg
  - dma-ranges
  - "#interconnect-cells"

additionalProperties: false

examples:
  - |
    dram-controller@0 {
        compatible = "spacemit,k1-mbus";
        reg = <0x00000000 0x80000000>;
        dma-ranges = <0x00000000 0x00000000 0x80000000>;
        #address-cells = <1>;
        #size-cells = <1>;
        #interconnect-cells = <0>;
    };
```
